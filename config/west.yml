## config/west.yml
```yaml
manifest:
  remotes:
    - name: zmkfirmware
      url-base: https://github.com/petejohanson
    - name: gpeye
      url-base: https://github.com/GPeye
  projects:
    - name: zmk
      remote: zmkfirmware
      revision: feat/pointers-with-input-processors
      import: app/west.yml
    - name: urchin-peripheral-animation
      remote: gpeye
      revision: main 
  self:
    path: config
```
